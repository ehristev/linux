## mm/kmemdump/Kconfig.debug
```kconfig
# SPDX-License-Identifier: GPL-2.0

menuconfig KMEMDUMP
	bool "KMEMDUMP: Register memory regions for dumping purpose"
	help
	  Kmemdump mechanism allows any driver to mark a specific memory area
	  for later dumping/debugging purpose, depending on the functionality
	  of the attached backend.
	  The backend would interface any hardware mechanism that will allow
	  dumping to complete regardless of the state of the kernel
	  (running, frozen, crashed, or any particular state).

	  Note that modules using this feature must be rebuilt if option
	  changes.

config KMEMDUMP_COREIMAGE
	depends on KMEMDUMP
	select VMCORE_INFO
	bool "Assemble memory regions into a coredump readable with debuggers"
	help
	  Enabling this will assemble all the memory regions into a
	  core ELF file. The first region will include program headers for
	  all the regions. The second region is the vmcoreinfo and specific
	  coredump structures.
	  All the other regions follow. Specific kernel variables required
	  for debug tools are being registered.
	  The coredump file can then be loaded into GDB or crash  tool and
	  further inspected.
```
